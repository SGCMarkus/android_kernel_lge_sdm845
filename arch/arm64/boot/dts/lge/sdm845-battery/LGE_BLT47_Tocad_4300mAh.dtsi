qcom,LGE_BLT47_Tocad_4300mAh {
	qcom, = <24>;
	/* constant parameter */
	lge,fg-cutoff-voltage = <3200>;
	lge,fg-cutoff-current = <200>;
	lge,fg-esr-tight-lt-filter-micro-pct = <30000>;
	lge,fg-esr-broad-lt-filter-micro-pct = <30000>;
	lge,dynamic-ki-en;
	//lge,ki-coeff-chg-enable;
	lge,ki-coeff-dischg-enable;
	lge,ki-coeff-soc-alert = <7>;
	lge,ki-coeff-comp = <200>;
	lge,ki-coeff-margin-vfloat-mv = <100>;
	lge,ki-coeff-limit = <300 20000>; //min max
	/* runtime charging parameter */
	lge,ki-coeff-curr-lowth-dischg = <100>;
	lge,ki-coeff-curr-highth-dischg = <900>;
	lge,ki-coeff-soc-dischg = <30 60 100>;
	lge,ki-coeff-low-dischg = <800 800 800>;
	lge,ki-coeff-med-dischg = <1500 1500 1500>;
	lge,ki-coeff-hi-dischg = <2200 2200 2200>;
	lge,ki-coeff-hi-chg = <300>;
	/* #4359036_LGE_BLT47atl_4300mAh_averaged_MasterSlave_Jan21st2020*/
	qcom,max-voltage-uv = <4450000>;
	qcom,fg-cc-cv-threshold-mv = <4430>;
	qcom,nom-batt-capacity-mah = <4300>;
	qcom,fastchg-current-ma = <4000>;
	qcom,batt-id-kohm = <49>;
	qcom,battery-beta = <4250>;
	qcom,battery-type = "LGE_BLT47_Tocad_4300mAh";
	qcom,checksum = <0x28B0>;
	qcom,gui-version = "PMI8998GUI - 2.0.0.58";
	qcom,fg-profile-data = [
		 3E 21 BF 0D
		 31 12 4F 04
		 FC 1C A3 01
		 F0 04 E5 03
		 9D 18 62 23
		 B6 44 31 5A
		 85 00 00 00
		 10 00 00 00
		 00 00 D8 BB
		 68 CC EC BA
		 1B 00 08 00
		 01 00 D5 E5
		 B2 06 35 F3
		 70 D4 BC 12
		 E4 04 15 03
		 1B 06 09 20
		 27 00 14 00
		 A6 20 36 04
		 F2 0B 9F 04
		 E3 1C BF 02
		 60 0C 14 12
		 AD 18 A8 23
		 21 44 D6 5A
		 6E 00 00 00
		 0E 00 00 00
		 00 00 A9 CC
		 F2 C2 B0 A3
		 18 00 00 00
		 24 EA D5 E5
		 F3 06 4F F2
		 8F FD C9 02
		 BB 06 F5 13
		 99 33 CC FF
		 07 10 00 00
		 C6 10 33 47
		 18 00 40 00
		 82 01 0A FA
		 FF 00 00 00
		 00 00 00 00
		 00 00 00 00
		 00 00 00 00
		 00 00 00 00
		 00 00 00 00
		 00 00 00 00
		 00 00 00 00
		 00 00 00 00
		 00 00 00 00
		 00 00 00 00
		 00 00 00 00
		 00 00 00 00
		 00 00 00 00
		 00 00 00 00
		 00 00 00 00
		 00 00 00 00
		 00 00 00 00
		 00 00 00 00
	];
};
