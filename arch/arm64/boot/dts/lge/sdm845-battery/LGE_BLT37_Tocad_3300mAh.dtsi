
qcom,LGE_BLT37_Tocad_3300mAh {
	qcom, = <24>;
	/* fg feature for battery charactistics */
	/* constant parameter */
	lge,fg-cutoff-voltage = <3200>;
	lge,fg-cutoff-current = <200>;
	lge,fg-esr-tight-lt-filter-micro-pct = <30000>;
	lge,fg-esr-broad-lt-filter-micro-pct = <30000>;

	/* runtime changing parameter */
	lge,ki-coeff-curr-lowth-dischg = <200>;
	lge,ki-coeff-curr-highth-dischg = <1000>;
	lge,ki-coeff-soc-dischg = <30 60 90>;
	lge,ki-coeff-low-dischg = <500 500 500>;
	lge,ki-coeff-med-dischg = <300 300 300>;
	lge,ki-coeff-hi-dischg = <300 300 300>;

	/* #3314156_LGE_BLT37tocad_3300mAh_averaged_MasterSlave_Jan29th2018*/
	qcom,max-voltage-uv = <4400000>;
	qcom,nom-batt-capacity-mah = <3300>;
	qcom,fastchg-current-ma = <3000>;
	qcom,batt-id-kohm = <46>;
	qcom,battery-beta = <4150>;
	qcom,fg-cc-cv-threshold-mv = <4390>;
	qcom,battery-type = "LGE_BLT37_Tocad_3300mAh";
	qcom,checksum = <0x6626>;
	qcom,gui-version = "PMI8998GUI - 2.0.0.58";
	qcom,fg-profile-data = [
		 82 1F B0 05
		 6B 0A BB FC
		 EA 1C CE 01
		 1F 04 41 0A
		 8D 17 12 2A
		 FC 4D B0 5A
		 79 00 00 00
		 10 00 00 00
		 00 00 00 00
		 26 CD 1A BA
		 26 00 08 00
		 FC E2 9A ED
		 6D 06 CE F2
		 6F FC 33 0B
		 A1 DD 4E 2A
		 21 06 09 20
		 24 00 14 00
		 AC 1F 95 05
		 8C 0A 59 FC
		 A2 1C 72 03
		 81 15 C8 12
		 63 18 26 2A
		 60 4D 3B 62
		 63 00 00 00
		 0C 00 00 00
		 00 00 B4 D5
		 65 CA 13 C2
		 1D 00 00 00
		 6A 00 9A ED
		 CD 06 97 EB
		 42 F4 79 02
		 79 FD 2F 1B
		 9B 33 CC FF
		 07 10 00 00
		 AE 0C 66 46
		 1D 00 40 00
		 97 01 0A FA
		 FF 00 00 00
		 00 00 00 00
		 00 00 00 00
		 00 00 00 00
		 00 00 00 00
		 00 00 00 00
		 00 00 00 00
		 00 00 00 00
		 00 00 00 00
		 00 00 00 00
		 00 00 00 00
		 00 00 00 00
		 00 00 00 00
		 00 00 00 00
		 00 00 00 00
		 00 00 00 00
		 00 00 00 00
		 00 00 00 00
		 00 00 00 00
	];
};
