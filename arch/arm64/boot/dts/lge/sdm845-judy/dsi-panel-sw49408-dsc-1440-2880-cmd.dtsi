/* Copyright (c) 2014, Code Aurora Forum. All rights reserved.
 *
 * This program is free software; you can redistribute it and/or modify
 * it under the terms of the GNU General Public License version 2 and
 * only version 2 as published by the Free Software Foundation.
 *
 * This program is distributed in the hope that it will be useful,
 * but WITHOUT ANY WARRANTY; without even the implied warranty of
 * MERCHANTABILITY or FITNESS FOR A PARTICULAR PURPOSE.  See the
 * GNU General Public License for more details.
 */

&mdss_mdp {
	dsi_sw49408_dsc_1440_2880_cmd: qcom,mdss_dsi_sw49408_dsc_1440_2880_cmd {
		qcom,mdss-dsi-panel-name = "SW49408 1440 2880 cmd mode dsc dsi panel";
		qcom,mdss-dsi-panel-type = "dsi_cmd_mode";
		qcom,mdss-dsi-virtual-channel-id = <0>;
		qcom,mdss-dsi-stream = <0>;
		qcom,mdss-dsi-bpp = <24>;
		qcom,mdss-dsi-color-order = "rgb_swap_rgb";
		qcom,mdss-dsi-underflow-color = <0xff>;
		qcom,mdss-dsi-border-color = <0>;

		qcom,mdss-dsi-traffic-mode = "burst_mode";
		qcom,mdss-dsi-bllp-eof-power-mode;
		qcom,mdss-dsi-bllp-power-mode;
//		qcom,partial-update-enabled;
		qcom,mdss-dsi-lane-0-state;
		qcom,mdss-dsi-lane-1-state;
		qcom,mdss-dsi-lane-2-state;
		qcom,mdss-dsi-lane-3-state;
		qcom,mdss-dsi-reset-sequence = <1 10>, <0 10>, <1 10>;
		qcom,mdss-dsi-bl-max-level = <4095>;
		qcom,adjust-timer-wakeup-ms = <1>;
		qcom,mdss-dsi-dma-trigger = "trigger_sw";
		qcom,mdss-dsi-mdp-trigger = "none";
		qcom,mdss-dsi-te-pin-select = <1>;
		qcom,mdss-dsi-wr-mem-start = <0x2c>;
		qcom,mdss-dsi-wr-mem-continue = <0x3c>;
		qcom,mdss-dsi-te-dcs-command = <1>;
		qcom,mdss-dsi-te-check-enable;
		qcom,mdss-dsi-te-using-te-pin;
//		qcom,ulps-enabled;
//		qcom,suspend-ulps-enabled;
		qcom,mdss-dsi-lp11-init;
		qcom,mdss-dsi-tx-eot-append;
//		qcom,mdss-mdp-transfer-time-us = <15200>;
		//qcom,esd-check-enabled;
		//qcom,mdss-dsi-panel-status-check-mode = "te_signal_check";

		qcom,mdss-dsi-panel-hdr-enabled;
		qcom,mdss-dsi-panel-hdr-color-primaries = <14649 15851 33084 15473 13806 31961 7476 2719>;
		qcom,mdss-dsi-panel-peak-brightness = <5000000>;	/* max. 500nits */
		qcom,mdss-dsi-panel-blackness-level = <3022>;

		lge,incell-panel;

		lge,blmap = <
			0
			3 3 3 3 3 3 3 3 3 17
			17 17 17 17 18 18 18 18 19 19
			19 19 20 20 21 22 23 24 25 26
			27 28 29 30 31 32 34 35 37 39
			40 42 44 45 47 49 50 52 54 57
			60 63 66 69 72 75 78 81 85 87
			90 93 96 99 102 105 108 111 114 117
			120 123 126 129 133 138 143 148 153 158
			163 168 173 179 185 190 196 202 208 214
			220 226 232 238 244 250 256 262 267 273
			279 284 290 296 302 307 313 319 325 331
			338 345 352 359 366 373 380 387 394 401
			408 415 423 432 441 450 458 467 476 485
			493 502 511 520 530 541 552 563 574 584
			595 606 617 628 639 649 659 669 679 689
			699 709 719 729 739 749 759 770 783 796
			810 823 836 850 863 876 890 903 916 930
			941 953 965 977 989 1001 1013 1025 1037 1049
			1061 1073 1085 1099 1113 1128 1142 1157 1171 1185
			1200 1214 1229 1243 1258 1273 1289 1305 1321 1337
			1353 1369 1385 1401 1417 1433 1449 1465 1484 1504
			1523 1543 1562 1582 1601 1621 1640 1660 1680 1698
			1717 1736 1755 1774 1793 1811 1830 1849 1868 1887
			1906 1925 1944 1964 1984 2004 2024 2044 2063 2083
			2103 2123 2143 2163 2189 2216 2243 2270 2297 2323
			2350 2377 2404 2431 2458
		>;

		lge,blmap-ex = <
			0
			70 70 70 70 70 70 70 70 70 70
			70 71 71 71 72 72 72 72 73 73
			73 74 74 75 76 78 79 80 81 82
			83 85 86 87 88 89 90 91 93 94
			95 96 97 98 99 101 102 103 104 105
			107 108 109 110 112 113 114 115 117 118
			119 120 121 123 124 125 126 127 128 130
			131 132 133 134 135 136 137 138 139 140
			141 142 143 144 145 146 147 148 149 150
			150 151 152 153 154 155 156 157 157 158
			159 160 160 161 162 163 163 164 165 165
			166 167 167 168 169 170 170 171 172 172
			173 174 174 175 175 176 177 177 178 179
			179 180 180 181 182 182 183 183 184 184
			185 185 186 186 187 187 188 189 189 190
			190 191 192 192 193 193 194 194 195 196
			196 197 197 198 198 199 199 200 200 201
			201 202 202 203 203 204 204 205 205 206
			206 207 207 207 208 208 209 209 209 210
			210 210 211 211 212 212 213 213 214 214
			215 215 216 216 217 217 218 218 218 219
			219 220 220 221 221 222 222 223 223 223
			224 224 224 225 225 225 226 226 226 227
			227 227 228 228 228 229 229 230 230 230
			231 231 231 232 232 232 233 233 234 234
			234 235 235 236 236
		>;

		qcom,mdss-pan-physical-width-dimension = <65>;
		qcom,mdss-pan-physical-height-dimension = <130>;

		qcom,mdss-dsi-t-clk-post = <0x0D>;
		qcom,mdss-dsi-t-clk-pre = <0x2B>;

		qcom,mdss-dsi-display-timings {
			timing@0{
				qcom,mdss-dsi-panel-phy-timings = [00 1B 07 06 22 21 07 07 04 03 04 00];
				qcom,display-topology = <1 1 1>, <2 1 1 >;
				qcom,default-topology-index = <1>;
				qcom,mdss-dsi-panel-framerate = <60>;
				qcom,mdss-dsi-panel-width = <1440>;
				qcom,mdss-dsi-panel-height = <2880>;
				qcom,mdss-dsi-h-front-porch = <168>;
				qcom,mdss-dsi-h-back-porch = <88>;
				qcom,mdss-dsi-h-pulse-width = <16>;
				qcom,mdss-dsi-h-sync-skew = <0>;
				qcom,mdss-dsi-v-back-porch = <10>;
				qcom,mdss-dsi-v-front-porch = <9>;
				qcom,mdss-dsi-v-pulse-width = <1>;
				qcom,mdss-dsi-h-left-border = <0>;
				qcom,mdss-dsi-h-right-border = <0>;
				qcom,mdss-dsi-v-top-border = <0>;
				qcom,mdss-dsi-v-bottom-border = <0>;
				qcom,mdss-dsi-on-command = [
					/* Manufacturer Command Protection */
					15 01 00 00 00 00 02 B0 AC
					/*Left Side GIP pad setting*/
					39 01 00 00 00 00 0E E5 1A 0D 0C 0E 1A 1A 01 05 07 09 0B 1A 11
					/*Right Side GIP pad setting*/
					39 01 00 00 00 00 0E E6 1A 0D 0C 0E 1A 1A 00 04 06 08 0A 1A 11
					/*Left Side Mux Pad Setting*/
					39 01 00 00 00 00 07 E7 18 17 16 15 14 13
					/*Right Side Mux Pad Setting*/
					39 01 00 00 00 00 07 E8 18 17 16 15 14 13
					/* Page Address Set */
					39 01 00 00 00 00 05 2B 00 00 0B 3F
					/* Partial Area Set */
					39 01 00 00 00 00 05 30 00 00 03 1F
					/* Tearing Effect Line on */
					15 01 00 00 00 00 02 35 00
					/* Write Display Brightness */
					15 01 00 00 00 00 02 51 FF
					/* Write Control Display */
					15 01 00 00 00 00 02 53 2C
					/* Display Control 1 */
					39 01 00 00 00 00 08 B3 08 07 28 C8 1A 94 02
					/* Display Control 2 */
					39 01 00 00 00 00 0E B4 91 08 00 0C 0C 0C 0C 0A 0A 0A 0A 0A 0A
					/* Display Control 3 */
					39 01 00 00 00 00 0F B5 28 14 2A C8 3E 00 00 00 00 C0 93 13 31 31
					/* Display Control 4 */
					39 01 00 00 00 00 09 B6 26 0F 10 C0 00 2C C2 00
					/* Panel Setting */
					39 01 00 00 00 00 05 B7 61 F5 EC B3
					/* Touch Timing Control */
					39 01 00 00 00 00 20 B8 17 02 90 40 CA A0 0C 00 00 18 33 04 01 90 01 45 16 C2 21 00 00 10 01 15 01 0A 00 50 0A 40 9C
					/* Touch Source Setting */
					39 01 00 00 00 00 06 B9 64 64 2A 3F EE
					/* Internal Oscillator Setting */
					39 01 00 00 00 00 04 C0 9C 08 10
					/* Power Control 1 */
					39 01 00 00 00 00 07 C1 01 00 F0 C2 CF 0C
					/* Power Control 2 */
					39 01 00 00 00 00 05 C2 CC 44 44 00
					/* Power Control 3 */
					39 01 00 00 00 00 09 C3 35 44 22 26 21 00 15 DD
					/* Power Control 4 */
					39 01 00 00 00 00 05 C4 0A 02 9E A4
					/* Power Control 5 */
					39 01 00 00 00 00 07 C5 A2 38 28 94 D4 0F
					/* Power Sequence Option Configuration */
					39 01 00 00 00 00 06 C9 05 5D 03 04 01
					/* APO Control */
					39 01 00 00 00 00 03 CA 9F 10
					/* LFD Control */
					39 01 00 00 00 00 06 CB 73 90 3D 3D 8C
					/* Tail TFT Setting */
					39 01 00 00 00 00 06 CC 14 50 50 90 41
					/* U2 Control */
					39 01 00 00 00 00 04 CD 67 86 C0
					/* U2 Vcom offset */
					39 01 00 00 00 00 03 CE 03 00
					/* Positive Gamma Curve for Red */
					39 01 00 00 00 00 0E D0 00 10 20 2F 3B 43 4E 44 37 28 17 06 03
					/* Negative Gamma Curve for Red */
					39 01 00 00 00 00 0E D1 00 10 20 2B 38 41 4C 44 37 28 17 00 03
					/* Positive Gamma Curve for Green */
					39 01 00 00 00 00 0E D2 00 10 20 2F 3B 42 4F 44 37 28 17 06 03
					/* Negative Gamma Curve for Green */
					39 01 00 00 00 00 0E D3 00 10 20 2B 38 40 4D 44 37 28 17 00 03
					/* Positive Gamma Curve for Blue */
					39 01 00 00 00 00 0E D4 00 10 20 2F 3B 43 4E 44 37 28 17 06 03
					/* Negative Gamma Curve for Blue */
					39 01 00 00 00 00 0E D5 00 10 20 2B 38 41 4C 44 37 28 17 00 03
					/* Test1 */
					39 01 00 00 00 00 07 ED 61 68 00 90 20 00
					/* Write Content Adaptive Brightness Control */
					15 01 00 00 00 00 02 55 80
					/* IE Setting1 */
					15 01 00 00 00 00 02 F0 C2
					/* IE Setting2 */
					39 01 00 00 00 00 05 F2 01 00 04 00
					/* IE Setting3 */
					39 01 00 00 00 00 0D F3 00 43 8B C0 00 01 13 00 00 00 00 00
					/* CABC Control 1*/
					39 01 00 00 00 00 18 FA 20 40 60 80 A0 C0 E0 10 1C 20 20 1F 16 18 00 B4 C0 CD DA E8 F0 F7 FF
					/* CABC Control 2*/
					39 01 00 00 00 00 0E FB B1 80 D0 06 40 7B 02 FF 12 22 22 12 22
					/* Normal Display mode on */
					05 01 00 00 00 00 01 13
					/* SRE Control 1*/
					15 01 00 00 00 00 02 F7 07
					/* SRE Control 2*/
					39 01 00 00 00 00 19 F8 00 2A 55 78 98 B6 D0 E7 00 3A 65 88 A7 C1 DA E8 00 41 6C 91 AE C8 DF EF
					/* Display On */
					05 01 00 00 00 00 01 29
					/* Sleep Out + min 90ms */
					05 01 00 00 5A 00 01 11
				];
				qcom,mdss-dsi-off-command = [
					/* Display Off */
					05 01 00 00 00 00 01 28
					/* Sleep In + min 90ms */
					05 01 00 00 5A 00 01 10
				];
				qcom,mdss-dsi-on-command-state = "dsi_lp_mode";
				qcom,mdss-dsi-off-command-state = "dsi_hs_mode";
				qcom,mdss-dsi-h-sync-pulse = <0>;
				qcom,compression-mode = "dsc";
				qcom,mdss-dsc-slice-height = <160>;
				qcom,mdss-dsc-slice-width = <1440>;
				qcom,mdss-dsc-slice-per-pkt = <1>;
				qcom,mdss-dsc-bit-per-component = <8>;
				qcom,mdss-dsc-bit-per-pixel = <8>;
				qcom,mdss-dsc-block-prediction-enable;
			};
		};
	};
};


