/* Copyright (c) 2014, The Linux Foundation. All rights reserved.
 *
 * This program is free software; you can redistribute it and/or modify
 * it under the terms of the GNU General Public License version 2 and
 * only version 2 as published by the Free Software Foundation.
 *
 * This program is distributed in the hope that it will be useful,
 * but WITHOUT ANY WARRANTY; without even the implied warranty of
 * MERCHANTABILITY or FITNESS FOR A PARTICULAR PURPOSE.  See the
 * GNU General Public License for more details.
 */

&qupv3_se5_spi {
	sw49410 {
		compatible = "lge,sw49410";
		reg = <2>;
		status = "disable";
		interrupt-parent = <&tlmm>;
		interrupts = <31 0x2008>;
		irqflags = <0x00000002>;
		spi-max-frequency = <50000000>;

		reset-gpio = <&tlmm 32 0x00>;
		irq-gpio = <&tlmm 31 0x2008>;

		/* caps */
		max_x = <1439>;
		max_y = <3119>;
		max_pressure = <0xff>;
		max_width_major = <1439>;
		max_width_minor = <3119>;
		max_orientation = <90>;
		max_id = <10>;
		hw_reset_delay = <90>;
		sw_reset_delay = <10>;

		/* role */
		use_lpwg = <1>;
		use_lpwg_test = <1>;
		hide_coordinate = <1>;

		/* firmware */
		fw_image = "touch/judyln/SW49410_L0W60NEO_1_07.img";

		panel_spec = "touch/judyln/judyln_limit.txt";
		panel_spec_mfts_folder = "touch/judyln/judyln_limit_mfts.txt";

		/* asc */
		use_asc = <0>;
		low_delta_thres = <350>;
		high_delta_thres = <600>;
		max_delta_cnt = <2>;

		/* Performance Test */
		use_perf_test = <1>;
		test_delay = <8>;
		test_pressure = <50>;
		test_width = <100>;
		click_test_x = <180>;
		click_test_y = <760>;
		v_drag_test_x = <144>;
		v_drag_test_start_y = <2003>;
		v_drag_test_end_y = <1116>;
		h_drag_test_start_x = <1163>;
		h_drag_test_end_x = <276>;
		h_drag_test_y = <2184>;
	};
};
