/* Copyright (c) 2017, The Linux Foundation. All rights reserved.
 *
 * This program is free software; you can redistribute it and/or modify
 * it under the terms of the GNU General Public License version 2 and
 * only version 2 as published by the Free Software Foundation.
 *
 * This program is distributed in the hope that it will be useful,
 * but WITHOUT ANY WARRANTY; without even the implied warranty of
 * MERCHANTABILITY or FITNESS FOR A PARTICULAR PURPOSE.  See the
 * GNU General Public License for more details.
 */

#include <dt-bindings/gpio/gpio.h>
#include <dt-bindings/clock/qcom,gcc-sdm845.h>
#include <dt-bindings/clock/qcom,camcc-sdm845.h>
#include <dt-bindings/clock/qcom,dispcc-sdm845.h>
#include <dt-bindings/clock/qcom,rpmh.h>
#include <dt-bindings/interrupt-controller/arm-gic.h>
#include "../../../qcom/sdm845-pmic-overlay.dtsi"
#include "../../../qcom/sdm845-pinctrl-overlay.dtsi"
#include "../sdm845-judy_common/sdm845-judy_common.dtsi"
#include "sdm845-judyp_lao_com-pinctrl.dtsi"
#include "sdm845-judyp_lao_com-panel.dtsi"
#include "sdm845-judyp_lao_com-misc.dtsi"
#include "sdm845-judyp_lao_com-pm.dtsi"
#include "sdm845-judyp_lao_com-sound.dtsi"
#include "sdm845-judyp_lao_com-connectivity.dtsi"
#include "sdm845-judyp_lao_com-nfc.dtsi"
#include "sdm845-judyp_lao_com-mme.dtsi"
#include "sdm845-judyp_lao_com-touch.dtsi"
#include "../sdm845-camera/sdm845-judy-camera.dtsi"
#include "sdm845-judyp_lao_com-fingerprint.dtsi"
#include "sdm845-judyp_lao_com-usb.dtsi"
#include "sdm845-judyp_lao_com-storage.dtsi"
#include "sdm845-judyp_lao_com-pkm.dtsi"

