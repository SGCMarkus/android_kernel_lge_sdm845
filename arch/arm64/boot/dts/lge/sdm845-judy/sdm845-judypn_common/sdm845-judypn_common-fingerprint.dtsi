/* Copyright (c) 2017, The Linux Foundation. All rights reserved.
 *
 * This program is free software; you can redistribute it and/or modify
 * it under the terms of the GNU General Public License version 2 and
 * only version 2 as published by the Free Software Foundation.
 *
 * This program is distributed in the hope that it will be useful,
 * but WITHOUT ANY WARRANTY; without even the implied warranty of
 * MERCHANTABILITY or FITNESS FOR A PARTICULAR PURPOSE.  See the
 * GNU General Public License for more details.
 */

&qupv3_se5_spi { /* QUP5 */
	status = "disable";
};

&soc{
	fingerprint@0 {
		status = "ok";
		compatible = "goodix,fingerprint";

		interrupt-parent = <&tlmm>;
		interrupts = <121>;

		goodix,gpio_irq = <&tlmm 121 0x00>;
		goodix,gpio_reset = <&tlmm 122 0x00>;
		goodix,gpio_cs  = <&tlmm 88 0x00>;
		goodix,vddio-supply = <&pm8998_l22>;
		gf,vddio-uV = <2800000>;
	};
};
