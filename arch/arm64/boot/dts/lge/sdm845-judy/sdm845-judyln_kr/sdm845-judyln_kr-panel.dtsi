/* Copyright (c) 2017, The Linux Foundation. All rights reserved.
 *
 * This program is free software; you can redistribute it and/or modify
 * it under the terms of the GNU General Public License version 2 and
 * only version 2 as published by the Free Software Foundation.
 *
 * This program is distributed in the hope that it will be useful,
 * but WITHOUT ANY WARRANTY; without even the implied warranty of
 * MERCHANTABILITY or FITNESS FOR A PARTICULAR PURPOSE.  See the
 * GNU General Public License for more details.
 */

#include "../sdm845-judy_common/sdm845-judy_common-panel.dtsi"

&labibb {
	status = "ok";
	qcom,qpnp-labibb-mode = "lcd";
	qcom,labibb-touch-to-wake-en = <1>;
};

&ibb_regulator {
	qcom,qpnp-ibb-lab-pwrup-delay = <1000>;
	qcom,qpnp-ibb-lab-pwrdn-delay = <2000>;
};

&pmi8998_wled {
	status = "okay";
	qcom,fs-curr-ua = <20000>;
	qcom,led-strings-list = [00 01 02];
	qcom,en-cabc;
	/delete-property/ qcom,auto-calibration-enable;
};
