/* Copyright (c) 2017, The Linux Foundation. All rights reserved.
 *
 * This program is free software; you can redistribute it and/or modify
 * it under the terms of the GNU General Public License version 2 and
 * only version 2 as published by the Free Software Foundation.
 *
 * This program is distributed in the hope that it will be useful,
 * but WITHOUT ANY WARRANTY; without even the implied warranty of
 * MERCHANTABILITY or FITNESS FOR A PARTICULAR PURPOSE.  See the
 * GNU General Public License for more details.
 */

#include <dt-bindings/gpio/gpio.h>
#include <dt-bindings/clock/qcom,gcc-sdm845.h>
#include <dt-bindings/clock/qcom,camcc-sdm845.h>
#include <dt-bindings/clock/qcom,dispcc-sdm845.h>
#include <dt-bindings/clock/qcom,rpmh.h>
#include <dt-bindings/interrupt-controller/arm-gic.h>
#include "../../../qcom/sdm845-pmic-overlay.dtsi"
#include "../../../qcom/sdm845-pinctrl-overlay.dtsi"
#include "../sdm845-judy_common/sdm845-judy_common.dtsi"
#include "sdm845-judyln_kr-pinctrl.dtsi"
#include "sdm845-judyln_kr-panel.dtsi"
#include "sdm845-judyln_kr-misc.dtsi"
#include "sdm845-judyln_kr-pm.dtsi"
#include "sdm845-judyln_kr-sound.dtsi"
#include "sdm845-judyln_kr-connectivity.dtsi"
#include "sdm845-judyln_kr-nfc.dtsi"
#include "sdm845-judyln_kr-mme.dtsi"
#include "sdm845-judyln_kr-touch.dtsi"
#include "../sdm845-camera/sdm845-judy-camera.dtsi"
#include "sdm845-judyln_kr-usb.dtsi"
#include "sdm845-judyln_kr-storage.dtsi"
#include "sdm845-judyln_kr-pkm.dtsi"

