/* Copyright (c) 2017, The Linux Foundation. All rights reserved.
 *
 * This program is free software; you can redistribute it and/or modify
 * it under the terms of the GNU General Public License version 2 and
 * only version 2 as published by the Free Software Foundation.
 *
 * This program is distributed in the hope that it will be useful,
 * but WITHOUT ANY WARRANTY; without even the implied warranty of
 * MERCHANTABILITY or FITNESS FOR A PARTICULAR PURPOSE.  See the
 * GNU General Public License for more details.
 */

#include "../sdm845-judy_common/sdm845-judy_common-panel.dtsi"

&labibb {
	status = "ok";
	qcom,qpnp-labibb-mode = "amoled";
	qcom,swire-control;
};

&pmi8998_wled {
	status = "ok";
	qcom,disp-type-amoled;
	qcom,avdd-target-voltage-mv = <6700>;
};

&dsi_sim_cmd {
	qcom,mdss-dsi-bl-pmic-control-type = "bl_ctrl_dcs";
	lge,panel-pins =
		<&tlmm 2 0>,  // vddio
		<&tlmm 113 0>; // vpnl
};

&sde_dp {
	lge,dp-use;
	lge,pre-emphasis-ovwr0 = /bits/ 8 < 0x0E >;
        lge,pre-emphasis-ovwr1 = /bits/ 8 < 0x0E >;
        lge,pre-emphasis-ovwr2 = /bits/ 8 < 0x0E >;
        lge,voltage-swing-ovwr0 = /bits/ 8 < 0x07 >;
        lge,voltage-swing-ovwr1 = /bits/ 8 < 0x13 >;
        lge,voltage-swing-ovwr2 = /bits/ 8 < 0x1B >;
};
