/* Copyright (c) 2017, The Linux Foundation. All rights reserved.
 *
 * This program is free software; you can redistribute it and/or modify
 * it under the terms of the GNU General Public License version 2 and
 * only version 2 as published by the Free Software Foundation.
 *
 * This program is distributed in the hope that it will be useful,
 * but WITHOUT ANY WARRANTY; without even the implied warranty of
 * MERCHANTABILITY or FITNESS FOR A PARTICULAR PURPOSE.  See the
 * GNU General Public License for more details.
 */

#include "../sdm845-judy_common/sdm845-judy_common-storage.dtsi"

&firmware {
	android {
		compatible = "android,firmware";
		fstab {
			compatible = "android,fstab";
			OP {
				compatible = "android,op";
				dev = "/dev/block/platform/soc/1d84000.ufshc/by-name/OP";
				type = "ext4";
				mnt_point = "/oem/OP";
				mnt_flags = "ro,noatime,nosuid,nodev,barrier=1,data=ordered,noauto_da_alloc";
				fsmgr_flags = "wait,slotselect,avb,nofail";
				status = "ok";
			};
		};
	};
};