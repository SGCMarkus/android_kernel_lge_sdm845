/* Copyright (c) 2017, The Linux Foundation. All rights reserved.
 *
 * This program is free software; you can redistribute it and/or modify
 * it under the terms of the GNU General Public License version 2 and
 * only version 2 as published by the Free Software Foundation.
 *
 * This program is distributed in the hope that it will be useful,
 * but WITHOUT ANY WARRANTY; without even the implied warranty of
 * MERCHANTABILITY or FITNESS FOR A PARTICULAR PURPOSE.  See the
 * GNU General Public License for more details.
 */


/dts-v1/;
/plugin/;

#include "sdm845-judyln_lao_ldu.dtsi"
#include "sdm845-judyln_lao_ldu-fingerprint.dtsi"

/ {
	model = "Qualcomm Technologies, Inc. SDM845 V2 - LG Electronics, judyln_ldu rev_0";
	compatible = "qcom,sdm845-mtp", "qcom,sdm845", "qcom,mtp";
	qcom,msm-id = <321 0x20000>;
	qcom,board-id = <0x02030008 0>;
};

&pmi8998_pdphy {
	lge,moisture-method = <0>;
};
