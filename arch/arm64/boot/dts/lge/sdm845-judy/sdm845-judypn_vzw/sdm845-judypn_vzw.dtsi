/* Copyright (c) 2017, The Linux Foundation. All rights reserved.
 *
 * This program is free software; you can redistribute it and/or modify
 * it under the terms of the GNU General Public License version 2 and
 * only version 2 as published by the Free Software Foundation.
 *
 * This program is distributed in the hope that it will be useful,
 * but WITHOUT ANY WARRANTY; without even the implied warranty of
 * MERCHANTABILITY or FITNESS FOR A PARTICULAR PURPOSE.  See the
 * GNU General Public License for more details.
 */

#include <dt-bindings/gpio/gpio.h>
#include <dt-bindings/clock/qcom,gcc-sdm845.h>
#include <dt-bindings/clock/qcom,camcc-sdm845.h>
#include <dt-bindings/clock/qcom,dispcc-sdm845.h>
#include <dt-bindings/clock/qcom,rpmh.h>
#include <dt-bindings/interrupt-controller/arm-gic.h>
#include "../../../qcom/sdm845-pmic-overlay.dtsi"
#include "../../../qcom/sdm845-pinctrl-overlay.dtsi"
#include "../sdm845-judy_common/sdm845-judy_common.dtsi"
#include "sdm845-judypn_vzw-pinctrl.dtsi"
#include "sdm845-judypn_vzw-panel.dtsi"
#include "sdm845-judypn_vzw-misc.dtsi"
#include "sdm845-judypn_vzw-pm.dtsi"
#include "sdm845-judypn_vzw-sound.dtsi"
#include "sdm845-judypn_vzw-connectivity.dtsi"
#include "sdm845-judypn_vzw-nfc.dtsi"
#include "sdm845-judypn_vzw-mme.dtsi"
#include "sdm845-judypn_vzw-tdmb.dtsi"
#include "sdm845-judypn_vzw-touch.dtsi"
#include "../sdm845-camera/sdm845-judy-camera.dtsi"
#include "sdm845-judypn_vzw-fingerprint.dtsi"
#include "sdm845-judypn_vzw-usb.dtsi"
#include "sdm845-judypn_vzw-storage.dtsi"
#include "sdm845-judypn_vzw-pkm.dtsi"

