/* Copyright (c) 2014, The Linux Foundation. All rights reserved.
 *
 * This program is free software; you can redistribute it and/or modify
 * it under the terms of the GNU General Public License version 2 and
 * only version 2 as published by the Free Software Foundation.
 *
 * This program is distributed in the hope that it will be useful,
 * but WITHOUT ANY WARRANTY; without even the implied warranty of
 * MERCHANTABILITY or FITNESS FOR A PARTICULAR PURPOSE.  See the
 * GNU General Public License for more details.
 */

&qupv3_se5_spi {
	sw49408 {
		compatible = "lge,sw49408";
		reg = <0>;
		status = "disable";
		interrupt-parent = <&tlmm>;
		interrupts = <31 0x2008>;
		irqflags = <0x00000002>;
		spi-max-frequency = <50000000>;

		reset-gpio = <&tlmm 32 0x00>;
		irq-gpio = <&tlmm 31 0x2008>;

		/* caps */
		max_x = <1439>;
		max_y = <2879>;
		max_pressure = <0xff>;
		max_width_major = <1439>;
		max_width_minor = <2879>;
		max_orientation = <90>;
		max_id = <10>;
		hw_reset_delay = <90>;
		sw_reset_delay = <10>;

		/* role */
		use_lpwg = <1>;
		use_lpwg_test = <0>;
		hide_coordinate = <0>;

		/* firmware */
		fw_image = "touch/judyln/L1L57P2_1_05.img",
			 "touch/judyln/L1L57P2_1_03.img";

		panel_spec = "touch/judyln/judyln_limit.txt";
		panel_spec_mfts_folder = "touch/judyln/judyln_limit_mfts.txt";

		/* asc */
		use_asc = <0>;
		low_delta_thres = <350>;
		high_delta_thres = <600>;
		max_delta_cnt = <2>;
	};
};
