## Documentation/devicetree/bindings/arm/msm/qcom,osm.txt
```
Qualcomm Technologies, Inc. OSM Bindings

Operating State Manager (OSM) is a hardware engine used by some Qualcomm
Technologies, Inc. (QTI) SoCs to manage frequency and voltage scaling
in hardware. OSM is capable of controlling frequency and voltage requests
for multiple clusters via the existence of multiple OSM domains.

Properties:
- compatible
	Usage:      required
	Value type: <string>
	Definition: must be "qcom,clk-cpu-osm", "qcom,clk-cpu-osm-v2" or
		    "qcom,clk-cpu-osm-sdm670".

- reg
	Usage:      required
	Value type: <prop-encoded-array>
	Definition: Addresses and sizes for the memory of the OSM controller.

- reg-names
	Usage:      required
	Value type: <stringlist>
	Definition: Address names. Must be "osm_l3_base", "osm_pwrcl_base",
		    "osm_perfcl_base".
		    Must be specified in the same order as the corresponding
		    addresses are specified in the reg property.

- qcom,mx-turbo-freq
	Usage:      optional
	Value type: <array>
	Definition: List of frequencies for the 3 clock domains (following the
		    order of L3, power, and performance clusters) that denote
		    the lowest rate that requires a TURBO vote on the MX rail.

- vdd_l3_mx_ao-supply
	Usage:      required if qcom,mx-turbo-freq is specified
	Value type: <phandle>
	Definition: Phandle to the MX active-only regulator device.

- vdd_pwrcl_mx_ao-supply
	Usage:      required if qcom,mx-turbo-freq is specified
	Value type: <phandle>
	Definition: Phandle to the MX active-only regulator device.

- l3-devs
	Usage: optional
	Value type: <phandle>
	Definition: List of phandles to devices that the OPP tables with the L3
		    frequency and voltage mappings are loaded for.

- clock-names
	Usage:      required
	Value type: <string>
	Definition: Must be "aux_clk".

- clocks
	Usage:      required
	Value type: <phandle>
	Definition: Phandle to the aux clock device.

- qcom,cpufreq-table-XX
	Usage: optional
	Value type: <u32>
	Definition: List of frequencies (in kHz) to expose in CPU XX's cpufreq table.
		    All frequencies present in hardware will be exposed if this list
		    is not present.

Example:
	clock_cpucc: qcom,cpucc@0x17d41000 {
		compatible = "qcom,clk-cpu-osm";
		reg = <0x17d41000 0x1400>,
			<0x17d43000 0x1400>,
			<0x17d45800 0x1400>;
		reg-names = "osm_l3_base", "osm_pwrcl_base", "osm_perfcl_base";
		vdd_l3_mx_ao-supply = <&pm8998_s6_level_ao>;
		vdd_pwrcl_mx_ao-supply = <&pm8998_s6_level_ao>;

		qcom,mx-turbo-freq = <1478400000 1689600000 3300000001>;
		l3-devs = <&l3_cpu0 &l3_cpu4 &l3_cdsp>;

		clock-names = "xo_ao";
		clocks = <&clock_rpmh RPMH_CXO_CLK_A>;
		#clock-cells = <1>;
		qcom,cpufreq-table-0 =
			< 300000>,
			< 403200>,
			< 480000>,
			< 576000>,
			< 672000>,
			< 768000>,
			< 864000>,
			< 979200>,
			<1075200>,
			<1171200>,
			<1267200>;

		qcom,cpufreq-table-4 =
			< 576000>,
			< 672000>,
			< 768000>,
			< 864000>,
			< 960000>,
			<1056000>,
			<1152000>,
			<1248000>,
			<1344000>,
			<1420800>,
			<1497600>,
			<1593600>,
			<1689600>,
			<1785600>,
			<1862400>,
			<1939200>,
			<2016000>;

		qcom,cpufreq-table-7 =
			< 691200>,
			< 768000>,
			< 864000>,
			< 940800>,
			<1017600>,
			<1113600>,
			<1190400>,
			<1286400>,
			<1363200>,
			<1459200>,
			<1536000>,
			<1632000>,
			<1728000>,
			<1824000>,
			<1900800>,
			<1977600>,
			<2054400>;
	};
```

## drivers/block/zram/Kconfig
```kconfig
config ZRAM
	tristate "Compressed RAM block device support"
	depends on BLOCK && SYSFS && ZSMALLOC && CRYPTO
	select CRYPTO_LZO
	default n
	help
	  Creates virtual block devices called /dev/zramX (X = 0, 1, ...).
	  Pages written to these disks are compressed and stored in memory
	  itself. These disks allow very fast I/O and compression provides
	  good amounts of memory savings.

	  It has several use cases, for example: /tmp storage, use as swap
	  disks and maybe many more.

	  See zram.txt for more information.

config ZRAM_ASYNC_IO
	bool "support asynchronous IO"
	depends on ZRAM && SMP
	default n
	help
	  Use background threads to compress IO data to leverage multiple
	  CPU power so that it can increase write throughput.
	  To enable the feature, echo 1 > /sys/block/zramX/async before
	  the setting disksize.
```

## drivers/input/fingerprint/Kconfig
```kconfig
#
# Fingerprints driver configuration
#
menuconfig INPUT_FINGERPRINT
	bool "FingerPrints"
	help
	  Say Y here, and a list of supported fingerprints will be displayed.
	  This option doesn't affect the kernel.

	  If unsure, say Y.

if INPUT_FINGERPRINT
config BBK_ET713
	tristate "Egis ET713 fingerprint drvier support"
	help
	  Say Y here to enable et713 fingerprint driver support!
	  
config INPUT_IX_BTP
       tristate "IX fingerprint sensor support"
       depends on SPI_MASTER
config INPUT_FINGERPRINT_FPC1020
	tristate "FPC1022 fingerprint sensor support by FPC"
	depends on SPI_MASTER
	help
	 Say Y here if you want to support FPC1022
	 connected via an SPI bus.

	 To compile this driver as a module, choose M here: the module
	 will be called FPC1022.
endif

config FINGERPRINT_GOODIX_GF3208
        tristate "Goodix GF3208 fingerprint drvier support"
	help
          Say Y here to enable goodix fingerprint driver support

config INPUT_FPC1145
        tristate "FPC1145 fingerprint sensor support"
        depends on SPI_MASTER

config EGISTEC_FINGERPRINT
	tristate "Egistec ET520 platform device"
	depends on SPI_MASTER
	help
	  If say Y here to use Egistec fingerprint driver.
	  If unsure, say N.
```

## drivers/input/touchscreen/lge/Kconfig
```kconfig
#
# LGE touch core configuration
#

if INPUT_TOUCHSCREEN

menuconfig LGE_TOUCH_CORE
	bool "LGE Touch Core - Generic"
	select LGE_TOUCH_CORE_BASE
	help
	  If your plaform is generic linux, say Y

menuconfig LGE_TOUCH_CORE_MTK
	bool "LGE Touch Core - MTK"
	select LGE_TOUCH_CORE_BASE
	help
	  If your plaform is mtk linux, say Y

menuconfig LGE_TOUCH_CORE_QCT
	bool "LGE Touch Core - QCT"
	select LGE_TOUCH_CORE_BASE
	help
	  If your plaform is qct linux, say Y

config LGE_TOUCH_CORE_BASE
	bool "LGE Touch Core Base"
	depends on SPI_MASTER && I2C

config LGE_TOUCH_FW_PATH
	string "LGE Touch Core Firmware Path"
	help
	LGE_TOUCH_FW_PATH is set to path of synaptics firmware

config SECURE_TOUCH
	bool "Secure Touch"
	help
	If touch dualization is applied, say Y

config LGE_TOUCH_PANEL_GLOBAL_RESET
	bool "LGE Touch panel global reset - ESD recovery"
	help
	If incell touch is applied, say Y

source "drivers/input/touchscreen/lge/lgsic/Kconfig"
source "drivers/input/touchscreen/lge/stm/Kconfig"
source "drivers/input/touchscreen/lge/synaptics/Kconfig"

endif
```

## drivers/input/touchscreen/lge/synaptics/Kconfig
```kconfig
#
# LGE touch core configuration
#

if INPUT_TOUCHSCREEN

menuconfig LGE_TOUCH_SYNAPTICS_S3707
	bool "LGE Touch Core ODM Device Driver - Synaptics(s3707)"
	depends on LGE_TOUCH_CORE_BASE
	help
	  If your device is synaptics(s3707), say Y

menuconfig LGE_TOUCH_SYNAPTICS_S3706_JUDY
	bool "LGE Touch Core ODM Device Driver - Synaptics(JUDY - s3706)"
	depends on LGE_TOUCH_CORE_BASE
	help
	  If your device is synaptics(s3706), say Y

endif
```

## drivers/power/supply/lge/Kconfig
```kconfig
config LGE_PM_VENEER_PSY
	bool "Apply LGE veneer psy"
	depends on LGE_PM
	default n
	help
	  Say Y here enable support lge veneer psy

config LGE_PM_ACTM
	bool "LGE Adaptive Charging Thermal Mitigation Engine"
	depends on LGE_PM
	default n
	help
	  Say Y here enable support lge actm

config LGE_PM_TTF_V2
	bool "LGE Time-To-Full Algorithm V2"
	depends on LGE_PM
	default n
	help
	  Say Y here enable support lge ttf v2

config LGE_PM_TTF_V3
	bool "LGE Time-To-Full Algorithm V3"
	depends on LGE_PM
	default n
	help
	  Say Y here enable support lge ttf v3

config LGE_PM_QNOVO_QNS
	bool "QNOVO QNS driver"
	depends on LGE_PM
	default n
	help
	  Say Y here to enable the Qnovo QNS solution.
```
