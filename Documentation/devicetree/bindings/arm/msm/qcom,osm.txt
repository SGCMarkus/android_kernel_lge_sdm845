## drivers/soc/qcom/lge/Kconfig
```kconfig
config MACH_LGE
	bool "Machine LGE"
	help
	  Support for machine LGE.

menu "LGE Board Selection"

config MACH_SDM845_JUDY
	bool "SDM845 JUDY"
	depends on ARCH_SDM845
	select MACH_LGE
	select LGE_DM_VERITY_RECOVERY
	help
	  Support for the Qualcomm SDM845 JUDY device.

config MACH_SDM845_JUDY_KR
	bool "SDM845 JUDY_KR"
	depends on ARCH_SDM845
	select MACH_LGE
	help
	  Support for the Qualcomm SDM845 JUDY_KR device.

config MACH_SDM845_JUDY_LGU_KR
	bool "SDM845 JUDY_LGU_KR"
	depends on ARCH_SDM845
	select MACH_LGE
	help
	  Support for the Qualcomm SDM845 JUDY_LGU_KR device.

config MACH_SDM845_JUDY_SKT_KR
        bool "SDM845 JUDY_SKT_KR"
        depends on ARCH_SDM845
        select MACH_LGE
        help
          Support for the Qualcomm SDM845 JUDY_SKT_KR device.

config MACH_SDM845_JUDY_KT_KR
        bool "SDM845 JUDY_KT_KR"
        depends on ARCH_SDM845
        select MACH_LGE
        help
          Support for the Qualcomm SDM845 JUDY_KT_KR device.

config MACH_SDM845_JUDY_LAO_COM
	bool "SDM845 JUDY_LAO_COM"
	depends on ARCH_SDM845
	select MACH_LGE
	help
	  Support for the Qualcomm SDM845 JUDY_LAO_COM device.

config MACH_SDM845_JUDY_LAO_LDU
	bool "SDM845 JUDY_LAO_LDU"
	depends on ARCH_SDM845
	select MACH_LGE
	help
	  Support for the Qualcomm SDM845 JUDY_LAO_LDU device.

config MACH_SDM845_JUDY_VZW
	bool "SDM845 JUDY_VZW"
	depends on ARCH_SDM845
	select MACH_LGE
	help
	  Support for the Qualcomm SDM845 JUDY_VZW device.

config MACH_SDM845_JUDY_SPR
	bool "SDM845 JUDY_SPR"
	depends on ARCH_SDM845
	select MACH_LGE
	help
	  Support for the Qualcomm SDM845 JUDY_SPR device.

config MACH_SDM845_JUDY_DCM_JP
	bool "SDM845 JUDY_DCM_JP"
	depends on ARCH_SDM845
	select MACH_LGE
	help
	  Support for the Qualcomm SDM845 JUDY_DCM_JP device.

config MACH_SDM845_JUDYLN
	bool "SDM845 JUDY"
	depends on ARCH_SDM845
	select MACH_LGE
	help
	  Support for the Qualcomm SDM845 JUDY device.

config MACH_SDM845_JUDYLN_KR
	bool "SDM845 JUDYLN_KR"
	depends on ARCH_SDM845
	select MACH_LGE
	help
	  Support for the Qualcomm SDM845 JUDYLN_KR device.

config MACH_SDM845_JUDYLN_LGU_KR
	bool "SDM845 JUDYLN_LGU_KR"
	depends on ARCH_SDM845
	select MACH_LGE
	help
	  Support for the Qualcomm SDM845 JUDYLN_LGU_KR device.

config MACH_SDM845_JUDYLN_SKT_KR
        bool "SDM845 JUDYLN_SKT_KR"
        depends on ARCH_SDM845
        select MACH_LGE
        help
          Support for the Qualcomm SDM845 JUDYLN_SKT_KR device.

config MACH_SDM845_JUDYLN_KT_KR
        bool "SDM845 JUDYLN_KT_KR"
        depends on ARCH_SDM845
        select MACH_LGE
        help
          Support for the Qualcomm SDM845 JUDYLN_KT_KR device.

config MACH_SDM845_JUDYLN_LAO_COM
	bool "SDM845 JUDYLN_LAO_COM"
	depends on ARCH_SDM845
	select MACH_LGE
	help
	  Support for the Qualcomm SDM845 JUDYLN_LAO_COM device.

config MACH_SDM845_JUDYLN_LAO_LDU
	bool "SDM845 JUDYLN_LAO_LDU"
	depends on ARCH_SDM845
	select MACH_LGE
	help
	  Support for the Qualcomm SDM845 JUDYLN_LAO_LDU device.

config MACH_SDM845_JUDYLN_VZW
	bool "SDM845 JUDYLN_VZW"
	depends on ARCH_SDM845
	select MACH_LGE
	help
	  Support for the Qualcomm SDM845 JUDYLN_VZW device.

config MACH_SDM845_JUDYLN_SPR
	bool "SDM845 JUDYLN_SPR"
	depends on ARCH_SDM845
	select MACH_LGE
	help
	  Support for the Qualcomm SDM845 JUDYLN_SPR device.

config MACH_SDM845_JUDYLN_DCM_JP
	bool "SDM845 JUDYLN_DCM_JP"
	depends on ARCH_SDM845
	select MACH_LGE
	help
	  Support for the Qualcomm SDM845 JUDYLN_DCM_JP device.

config MACH_SDM845_JUDYPN
	bool "SDM845 JUDY"
	depends on ARCH_SDM845
	select MACH_LGE
	help
	  Support for the Qualcomm SDM845 JUDY device.

config MACH_SDM845_JUDYPN_KR
	bool "SDM845 JUDYPN_KR"
	depends on ARCH_SDM845
	select MACH_LGE
	help
	  Support for the Qualcomm SDM845 JUDYPN_KR device.

config MACH_SDM845_JUDYPN_LGU_KR
	bool "SDM845 JUDYPN_LGU_KR"
	depends on ARCH_SDM845
	select MACH_LGE
	help
	  Support for the Qualcomm SDM845 JUDYPN_LGU_KR device.

config MACH_SDM845_JUDYPN_SKT_KR
        bool "SDM845 JUDYPN_SKT_KR"
        depends on ARCH_SDM845
        select MACH_LGE
        help
          Support for the Qualcomm SDM845 JUDYPN_SKT_KR device.

config MACH_SDM845_JUDYPN_KT_KR
        bool "SDM845 JUDYPN_KT_KR"
        depends on ARCH_SDM845
        select MACH_LGE
        help
          Support for the Qualcomm SDM845 JUDYPN_KT_KR device.

config MACH_SDM845_JUDYPN_LAO_COM
	bool "SDM845 JUDYPN_LAO_COM"
	depends on ARCH_SDM845
	select MACH_LGE
	help
	  Support for the Qualcomm SDM845 JUDYPN_LAO_COM device.

config MACH_SDM845_JUDYPN_VZW
	bool "SDM845 JUDYPN_VZW"
	depends on ARCH_SDM845
	select MACH_LGE
	help
	  Support for the Qualcomm SDM845 JUDYPN_VZW device.

config MACH_SDM845_JUDYPN_SPR
	bool "SDM845 JUDYPN_SPR"
	depends on ARCH_SDM845
	select MACH_LGE
	help
	  Support for the Qualcomm SDM845 JUDYPN_SPR device.

config MACH_SDM845_JUDYP
	bool "SDM845 JUDY"
	depends on ARCH_SDM845
	select MACH_LGE
	help
	  Support for the Qualcomm SDM845 JUDY device.

config MACH_SDM845_JUDYP_KR
	bool "SDM845 JUDYP_KR"
	depends on ARCH_SDM845
	select MACH_LGE
	help
	  Support for the Qualcomm SDM845 JUDYP_KR device.

config MACH_SDM845_JUDYP_LGU_KR
	bool "SDM845 JUDYP_LGU_KR"
	depends on ARCH_SDM845
	select MACH_LGE
	help
	  Support for the Qualcomm SDM845 JUDYP_LGU_KR device.

config MACH_SDM845_JUDYP_SKT_KR
        bool "SDM845 JUDYP_SKT_KR"
        depends on ARCH_SDM845
        select MACH_LGE
        help
          Support for the Qualcomm SDM845 JUDYP_SKT_KR device.

config MACH_SDM845_JUDYP_KT_KR
        bool "SDM845 JUDYP_KT_KR"
        depends on ARCH_SDM845
        select MACH_LGE
        help
          Support for the Qualcomm SDM845 JUDYP_KT_KR device.

config MACH_SDM845_JUDYP_LAO_COM
	bool "SDM845 JUDYP_LAO_COM"
	depends on ARCH_SDM845
	select MACH_LGE
	help
	  Support for the Qualcomm SDM845 JUDYP_LAO_COM device.

config MACH_SDM845_JUDYP_VZW
	bool "SDM845 JUDYP_VZW"
	depends on ARCH_SDM845
	select MACH_LGE
	help
	  Support for the Qualcomm SDM845 JUDYP_VZW device.

config MACH_SDM845_JUDYP_SPR
	bool "SDM845 JUDYP_SPR"
	depends on ARCH_SDM845
	select MACH_LGE
	help
	  Support for the Qualcomm SDM845 JUDYP_SPR device.

config MACH_SDM845_CAYMANSLM
	bool "SDM845 CAYMANSLM"
	depends on ARCH_SDM845
	select MACH_LGE
	help
	  Support for the Qualcomm SDM845 CAYMANSLM device.

config MACH_SDM845_STYLE3LM_DCM_JP
	bool "SDM845 STYLE3LM_DCM_JP"
	depends on ARCH_SDM845
	select MACH_LGE
	help
	  Support for the Qualcomm SDM845 STYLE3LM_DCM_JP device.

config LGE_BOOTLOADER_LOG
	tristate "Support LGE bootloader log"
	default n
	depends on MACH_LGE
	help
	  LGE bootloader log

config LGE_BOOTLOADER_TIME_CHECKER
	tristate "Supprt bootloader(LK, SBL) time"
	default n
	depends on MACH_LGE
	help
	  Check LK, SBL booting time at
	  sys/module/lge_bootloader_time_checker/parameters/lk_time
	  sys/module/lge_bootloader_time_checker/parameters/sbl_time

config LGE_PM
	tristate "SDM845 LGE POWER Feature"
	depends on SPMI || MSM_SPMI
	help
	  Say Y here to enable support for SDM845/PMI8998 chip lge feature.
	  Power Management, Battery charging, Battery Monitoring System
	  with battery FET and fuel gauge.

config LGE_PM_DEBUG
        tristate "Support LGE PM Debug Feature"
        default n
        depends on MACH_LGE
        help
	  LGE PM Debug Feature

config LGE_PM_PRM
	tristate "Support LGE Power resource manager"
	help
	  LGE power resource manager

endmenu

menu "LGE Specific Patches"

config LGE_HANDLE_PANIC
	tristate "Support LGE Crash Handler"
	default n
	depends on MACH_LGE
	select LGE_HANDLE_PANIC_RPMH_TIMEOUT
	help
	  LGE Crash Handler

config LGE_HANDLE_PANIC_RPMH_TIMEOUT
	tristate "Support LGE Crash Handler RPMH Timeout"
	default n
	depends on LGE_HANDLE_PANIC
	help
	  LGE Crash Handler

config LGE_PM_SMPL_COUNTER
	tristate "Support LGE SMPL COUNTER feature"
	default n
	depends on MACH_LGE
	help
	  Say y to enable smpl_cnt module, that count when
	  booted by SMPL

config LGE_QSDL_SUPPORT
	tristate "Support for Quality Statistics Data Logging"
	default n
	depends on MACH_LGE
	help
	  QSDL is a feature which notify infomation for quality statistics
	  data logging of device.

config LGE_PSTORE_BACKUP
	tristate "Support pstore backup"
	default n
	depends on MACH_LGE
	help
	  Ramoops region is backed up to pstore partition

config LGE_PKM
        tristate "Support PKM driver with QSEE"
        depends on MACH_LGE
        default y
        help
          Say Y here to enable Mobile Kernel Integrity driver for LG PKM

config LGE_ONE_BINARY_SKU
        tristate "Support LGE One binary sku carrier"
	default n
	depends on MACH_LGE
	help
	  LGE One Binary sku carrier

config LGE_DUAL_SCREEN
        bool "Support Dual Screen"
        depends on MACH_LGE
        help
          Say 'y" here to include support for dual screen.

config LGE_MME_BUS
        bool "Clock booster for LGE MME"
        depends on MACH_LGE
        default y
        help
          Say 'y' here to include support for the clock booster
          of msm bus to support LGE MME.

config LGE_PAY_MME
        tristate "Support WMC driver"
        depends on MACH_LGE
        default y
        help
          Say 'y' here to enable Wireless Magnetic Communication driver for LG pay

config LGE_PAY_MME_TEST
        tristate "Support WMC test"
        depends on MACH_LGE
        default n
        help
          Say 'y' here to enable Wireless Magnetic Communication test

config LGE_DM_VERITY_RECOVERY
	tristate "Support dm verity corrupt recovery"
	default n
	depends on MACH_LGE
	help
	  Sometimes, dm-bufio has invalid data. If data is corrupted,
	  try to recover data.

config LGE_POWEROFF_TIMEOUT
	bool "Support shutdown and reboot timeout"
	depends on MACH_LGE
	default y
	help
	  Say 'y" here to include support for shutdown and reboot timeout.

endmenu

menu "LGE QFPROM Values"

config LGE_QFPROM_INTERFACE
	bool "Support qfprom interface"
	default n
	depends on MACH_LGE
	help
	  LGE QFPROM DRIVER.

endmenu
```

## drivers/tspdrv/Kconfig
```kconfig
#
# tspdrv subsystem configuration
#

menu "Tspdrv support"

config TSPDRV
	tristate "TouchSense driver support"
	default n

source drivers/tspdrv/dw7800/Kconfig
source drivers/tspdrv/dw7912/Kconfig
source drivers/tspdrv/pmi8998/Kconfig

endmenu
```

## drivers/tspdrv/pmi8998/Kconfig
```kconfig
menu "TouchSense dw7800 driver support"

config PMI8998_HAPTICS
	tristate "Qualcomm pmi8998 haptics driver support"
	default n

endmenu
```

## drivers/usb/misc/lgmd/Kconfig
```kconfig
config LGE_USB_LGMD18_JUDY
	boolean "LGE USB Moisture Detector for JUDY in 2018"
	default y if LGE_USB_LGMD18 && MACH_SDM845_JUDY
	select LGE_USB_SWITCH_FUSB252
	help
	  Support moisture deteator for judy in 2018.
```

## techpack/audio/Kconfig
```kconfig
config DOLBY_DAP
	tristate "DOLBY_DAP"
config DOLBY_DS2
	tristate "DOLBY_DS2"
config DOLBY_LICENSE
	tristate "DOLBY_LICENSE"
config DTS_EAGLE
	tristate "DTS_EAGLE"
config DTS_SRS_TM
	tristate "DTS_SRS_TM"
config MSM_ADSP_LOADER
	tristate "MSM_ADSP_LOADER"
config MSM_AVTIMER
	tristate "MSM_AVTIMER"
config MSM_CDC_PINCTRL
	tristate "MSM_CDC_PINCTRL"
config MSM_GLINK_SPI_XPRT
	tristate "MSM_GLINK_SPI_XPRT"
config MSM_QDSP6_APRV2_GLINK
	tristate "MSM_QDSP6_APRV2_GLINK"
config MSM_QDSP6_NOTIFIER
	tristate "MSM_QDSP6_NOTIFIER"
config MSM_QDSP6_PDR
	tristate "MSM_QDSP6_PDR"
config MSM_QDSP6_SSR
	tristate "MSM_QDSP6_SSR"
config MSM_QDSP6V2_CODECS
	tristate "MSM_QDSP6V2_CODECS"
config MSM_ULTRASOUND
	tristate "MSM_ULTRASOUND"
config PINCTRL_WCD
	tristate "PINCTRL_WCD"
config PINMUX
	tristate "PINMUX"
config QTI_PP
	tristate "QTI_PP"
config REGMAP_SWR
	tristate "REGMAP_SWR"
config SMA6101_BATTERY_READING
	tristate "SMA6101_BATTERY_READING"
config SND_FM_RX_MI2S
	tristate "SND_FM_RX_MI2S"
config SND_HWDEP
	tristate "SND_HWDEP"
config SND_HWDEP_ROUTING
	tristate "SND_HWDEP_ROUTING"
config SND_LGE_CROSSTALK
	tristate "SND_LGE_CROSSTALK"
config SND_LGE_DSDP_DUAL_AUDIO
	tristate "SND_LGE_DSDP_DUAL_AUDIO"
config SND_LGE_DTS
	tristate "SND_LGE_DTS"
config SND_LGE_MABL
	tristate "SND_LGE_MABL"
config SND_LGE_STEREO_SPEAKER
	tristate "SND_LGE_STEREO_SPEAKER"
config SND_LGE_TX_NXP_LIB
	tristate "SND_LGE_TX_NXP_LIB"
config SND_LGE_WDSP_SSR
	tristate "SND_LGE_WDSP_SSR"
config SND_SOC_ES9218P
	tristate "SND_SOC_ES9218P"
config SND_SOC_LGE_ESS_DIGITAL_FILTER
	tristate "SND_SOC_LGE_ESS_DIGITAL_FILTER"
config SND_SOC_MACHINE_SDM845
	tristate "SND_SOC_MACHINE_SDM845"
config SND_SOC_MSM_HDMI_CODEC_RX
	tristate "SND_SOC_MSM_HDMI_CODEC_RX"
config SND_SOC_MSM_HOSTLESS_PCM
	tristate "SND_SOC_MSM_HOSTLESS_PCM"
config SND_SOC_MSM_QDSP6V2_INTF
	tristate "SND_SOC_MSM_QDSP6V2_INTF"
config SND_SOC_MSM_STUB
	tristate "SND_SOC_MSM_STUB"
config SND_SOC_QDSP6V2
	tristate "SND_SOC_QDSP6V2"
config SND_SOC_QDSP_DEBUG
	tristate "SND_SOC_QDSP_DEBUG"
config SND_SOC_SDM845
	tristate "SND_SOC_SDM845"
config SND_SOC_SMA6101
	tristate "SND_SOC_SMA6101"
config SND_SOC_TFA9872
	tristate "SND_SOC_TFA9872"
config SND_SOC_TFA9872_STEREO
	tristate "SND_SOC_TFA9872_STEREO"
config SND_SOC_WCD934X
	tristate "SND_SOC_WCD934X"
config SND_SOC_WCD934X_DSD
	tristate "SND_SOC_WCD934X_DSD"
config SND_SOC_WCD934X_MBHC
	tristate "SND_SOC_WCD934X_MBHC"
config SND_SOC_WCD9XXX_V2
	tristate "SND_SOC_WCD9XXX_V2"
config SND_SOC_WCD_MBHC
	tristate "SND_SOC_WCD_MBHC"
config SND_SOC_WCD_MBHC_ADC
	tristate "SND_SOC_WCD_MBHC_ADC"
config SND_SOC_WCD_MBHC_LEGACY
	tristate "SND_SOC_WCD_MBHC_LEGACY"
config SND_SOC_WCD_SPI
	tristate "SND_SOC_WCD_SPI"
config SND_SOC_WSA881X
	tristate "SND_SOC_WSA881X"
config SND_USE_MBHC_EXTN_CABLE
	tristate "SND_USE_MBHC_EXTN_CABLE"
config SND_USE_TERT_MI2S
	tristate "SND_USE_TERT_MI2S"
config SOUNDWIRE
	tristate "SOUNDWIRE"
config SOUNDWIRE_WCD_CTRL
	tristate "SOUNDWIRE_WCD_CTRL"
config USE_DEV_CTRL_VOLUME
	tristate "USE_DEV_CTRL_VOLUME"
config WCD9XXX_CODEC_CORE
	tristate "WCD9XXX_CODEC_CORE"
config WCD_DSP_GLINK
	tristate "WCD_DSP_GLINK"
config WCD_SPI_AC
	tristate "WCD_SPI_AC"
```
